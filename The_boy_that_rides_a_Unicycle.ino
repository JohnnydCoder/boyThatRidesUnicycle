const unsigned char playerImages[] PROGMEM = {
  10, 16,

  //Standing
  0x18, 0x24, 0x42, 0x95, 0xa1, 0xa1, 0x95, 0x42, 0x24, 0x18, 0x0c, 0x42, 0x7f, 0x0f, 0xff, 0xff,
  0x0f, 0x7f, 0x42, 0x0c, 
  //RunningR1
 0x18, 0x24, 0x42, 0x81, 0x91, 0xa1, 0xa9, 0x42, 0x24, 0x18, 0x0c, 0x02, 0x6f, 0x9f, 0xff, 0xbf,
0x9f, 0x6f, 0x02, 0x0c, 
  //RunningR2
  0x18, 0x24, 0x42, 0x81, 0x91, 0xa1, 0xa9, 0x42, 0x24, 0x18, 0x0c, 0x02, 0x6f, 0x9f, 0xbf, 0xff,
0x9f, 0x6f, 0x02, 0x0c, 
  //RunningL1
  0x18, 0x24, 0x42, 0xa9, 0xa1, 0x91, 0x81, 0x42, 0x24, 0x18, 0x0c, 0x02, 0x6f, 0x9f, 0xff, 0xbf,
0x9f, 0x6f, 0x02, 0x0c, 
  //RunningL2
  0x18, 0x24, 0x42, 0xa9, 0xa1, 0x91, 0x81, 0x42, 0x24, 0x18, 0x0c, 0x02, 0x6f, 0x9f, 0xbf, 0xff,
0x9f, 0x6f, 0x02, 0x0c, 
  //RunningF1
  0x18, 0x24, 0x42, 0x95, 0xa1, 0xa1, 0x95, 0x42, 0x24, 0x18, 0x0c, 0x82, 0xff, 0x0f, 0xff, 0xff,
  0x0f, 0x3f, 0x22, 0x0c, 
  //RunningF2
  0x18, 0x24, 0x42, 0x95, 0xa1, 0xa1, 0x95, 0x42, 0x24, 0x18, 0x0c, 0x22, 0x3f, 0x0f, 0xff, 0xff,
  0x0f, 0xff, 0x82, 0x0c, 
  //RunnningB1
 0x18, 0x3c, 0x7e, 0xff, 0xff, 0xff, 0xff, 0x7e, 0x3c, 0x18, 0x0c, 0x22, 0x3f, 0x0f, 0xff, 0xff,
0x0f, 0xff, 0x82, 0x0c, 
  //RunningB2
 0x18, 0x3c, 0x7e, 0xff, 0xff, 0xff, 0xff, 0x7e, 0x3c, 0x18, 0x0c, 0x82, 0xff, 0x0f, 0xff, 0xff,
0x0f, 0x3f, 0x22, 0x0c, 
};

const unsigned char dungeonFloor [] PROGMEM = {
  0x88, 0x88, 0x88, 0x8f, 0x88, 0xf8, 0x88, 0x88, 0x88, 0x88, 0xf8, 0x88, 0x8f, 0x88, 0x88, 0x88,
  0x88, 0x88, 0x88, 0x8f, 0x88, 0xf8, 0x88, 0x88, 0x88, 0x88, 0xf8, 0x88, 0x8f, 0x88, 0x88, 0x88,
};

const unsigned char spikeyImage[] PROGMEM = {
  //Spikey
  0xc3, 0xbd, 0x42, 0x5a, 0x5a, 0x42, 0xbd, 0xc3, 
};


const unsigned char title[] PROGMEM = {
 0x00, 0x00, 0x00, 0x00, 0x00, 0x01, 0x01, 0x01, 0xff, 0x01, 0x01, 0x01, 0x01, 0x01, 0x00, 0x00,
0x00, 0xff, 0x20, 0x20, 0xe0, 0x00, 0x00, 0x00, 0x00, 0x00, 0x00, 0xf0, 0xb0, 0xb0, 0x00, 0x00,
0x00, 0x00, 0x00, 0x00, 0x00, 0x00, 0x00, 0x00, 0xfe, 0x92, 0x92, 0x92, 0x94, 0xf8, 0x70, 0x00,
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0x00, 0x00, 0x00, 0x00, 0x01, 0x00, 0x00, 0x00, 0x00, 0x00, 0x00, 0x00, 0x00, 0x00, 0x00, 0x00,
};


#include <Arduboy2.h>
Arduboy2 arduboy;

#define PLAYER_WIDTH    10
#define PLAYER_HEIGHT  16
#define PLAYER_X_OFFSET   0
#define PLAYER_Y_OFFSET   HEIGHT / 2

Rect playerRect = {
  PLAYER_X_OFFSET, PLAYER_Y_OFFSET, PLAYER_WIDTH, PLAYER_HEIGHT
};

enum Stance {
  Standing,
  RunningR1,
  RunningR2,
  RunningL1,
  RunningL2,
  RunningF1,
  RunningF2,
  RunningB1,
  RunningB2,
};


struct Player {
  int x;
  int y;
  Stance stance;
  const unsigned char* image;
};

Player player = {PLAYER_X_OFFSET, PLAYER_Y_OFFSET, Stance::Standing, playerImages};

void drawplayer() {
player.image = playerImages[player.stance];
arduboy.fillRect(player.x, player.y, PLAYER_WIDTH, PLAYER_HEIGHT, BLACK);  
Sprites::drawExternalMask(player.x, player.y, playerImages, playerImages, player.stance, player.stance);
}

void playerinput() {
  if(arduboy.pressed(UP_BUTTON)) {
    if (player.y >= 0) {
      player.y -= 1;
    }
    
      if (arduboy.everyXFrames(7)) {  
  switch(player.stance) {
    case Stance::Standing:
    case Stance::RunningR1:
    case Stance::RunningL1:
    case Stance::RunningF1:
    player.stance = Stance::RunningB1;
    break;

    case Stance::RunningB1:
    player.stance = Stance::RunningB2;
    break;
    
    case Stance::RunningB2:
    case Stance::RunningF2:
    case Stance::RunningL2:
    case Stance::RunningR2:
    player.stance = Stance::RunningB1;
    break;
  }
  }
  }
  
  
  if(arduboy.pressed(DOWN_BUTTON)) {
    if (player.y + PLAYER_HEIGHT <= HEIGHT) {
      player.y += 1;
    }
    
     if (arduboy.everyXFrames(7)) {  
 switch(player.stance) {
    case Stance::Standing:
    case Stance::RunningB1:
    case Stance::RunningR1:
    case Stance::RunningL1:
    player.stance = Stance::RunningF1;
    break;

    case Stance::RunningF1:
    player.stance = Stance::RunningF2;
    break;
    
    case Stance::RunningF2:
    case Stance::RunningL2:
    case Stance::RunningR2:
    case Stance::RunningB2:
    player.stance = Stance::RunningF1;
    break;
  }
 }
}
  
  if(arduboy.pressed(LEFT_BUTTON)) {
    if (player.x >= 0) { 
      player.x -= 1;
    }
    
   if (arduboy.everyXFrames(7)) {  
  switch(player.stance) {
    case Stance::Standing:
    case Stance::RunningR1:
    case Stance::RunningB1:
    case Stance::RunningF1:
    player.stance = Stance::RunningL1;
    break;

    case Stance::RunningL1:
    player.stance = Stance::RunningL2;
    break;
    
    case Stance::RunningF2:
    case Stance::RunningL2:
    case Stance::RunningR2:
    case Stance::RunningB2:
    player.stance = Stance::RunningL1;
    break;
  }
 }
}

  if(arduboy.pressed(RIGHT_BUTTON)) {
    if (player.x + PLAYER_WIDTH <= WIDTH) {
      player.x += 1;
    }
    
  if (arduboy.everyXFrames(7)) {  
  switch(player.stance) {
    case Stance::Standing:
    case Stance::RunningL1:
    case Stance::RunningB1:
    case Stance::RunningF1:
    player.stance = Stance::RunningR1;
    break;

    case Stance::RunningR1:
    player.stance = Stance::RunningR2;
    break;
    
    case Stance::RunningF2:
    case Stance::RunningL2:
    case Stance::RunningR2:
    case Stance::RunningB2:
    player.stance = Stance::RunningR1;
    break;
  }
  }
  }
}


#define FLOOR   0
#define WORLD_HEIGHT    4
#define WORLD_WIDTH    8

int world [WORLD_HEIGHT] [WORLD_WIDTH] = {
{FLOOR, FLOOR, FLOOR, FLOOR, FLOOR, FLOOR, FLOOR, FLOOR},
{FLOOR, FLOOR, FLOOR, FLOOR, FLOOR, FLOOR, FLOOR, FLOOR},
{FLOOR, FLOOR, FLOOR, FLOOR, FLOOR, FLOOR, FLOOR, FLOOR},
{FLOOR, FLOOR, FLOOR, FLOOR, FLOOR, FLOOR, FLOOR, FLOOR},
};

 #define TILE_SIZE 16
void drawMap() {
  
  for(int y = 0; y < WORLD_HEIGHT; y++) {
    for(int x = 0; x < WORLD_WIDTH; x++) {
      if(world[y][x] == 0) {
        arduboy.drawBitmap(x * TILE_SIZE, y * TILE_SIZE, dungeonFloor, TILE_SIZE, TILE_SIZE, WHITE);
      }
    }
  }
}

#define WIDTH         128
#define HEIGHT        64
#define SPIKEY_WIDTH  8
#define SPIKEY_HEIGHT 8


bool moveRight = true;
bool moveDown = true;

struct Spikey {
  int x;
  int y;
};

Spikey spikey = {32, 32};

Rect spikeyRect = {
  spikey.x, spikey.y, SPIKEY_WIDTH, SPIKEY_HEIGHT
};

void spikeyMovement() {
  if (moveRight == true && spikey.x + SPIKEY_WIDTH <= WIDTH) {
    spikey.x += 1;
  }
  if (moveRight == false && spikey.x >= 0) {
    spikey.x -= 1;
  }
  if (spikey.x == 0) {
    if (rand() % 5 == 4) {
      spikey.x = WIDTH - SPIKEY_WIDTH;
      moveRight = false;
    }
    else {
    moveRight = true;
    }
  }
  if (spikey.x + SPIKEY_WIDTH == WIDTH) {
    if (rand() % 5 == 4) {
      spikey.x = 0;
      moveRight = true;
    }
    else {
    moveRight = false;
    }
  }
  if (moveDown == true && spikey.y + SPIKEY_HEIGHT <= HEIGHT) {
    spikey.y += 1;
  }
  if (moveDown == false && spikey.y >= 0) {
    spikey.y -= 1;
  }
  if (spikey.y == 0) {
    if (rand() % 5 == 4) {
      spikey.y = HEIGHT - SPIKEY_HEIGHT;
      moveDown = false;
    }
    else {
    moveDown = true;
    }
  }
  if (spikey.y + SPIKEY_HEIGHT == HEIGHT) {
    if (rand() % 5 == 4) {
      spikey.y = 0;
      moveDown = true;
    }
    else {
    moveDown = false;
    }
  }
}

void drawSpikey() {
arduboy.fillRect(spikey.x, spikey.y, 8, 8, BLACK);  
 arduboy.drawBitmap(spikey.x, spikey.y, spikeyImage, SPIKEY_WIDTH, SPIKEY_HEIGHT, WHITE);
}

#define GAME_TITLE  0
#define GAME_PLAY 1
#define GAME_OVER 2
#define GAME_HIGH 3
int gamestate = GAME_TITLE;

int score = 0;

void titlescreen() {
  score = 0;
  arduboy.setCursor(0, 0);
  arduboy.drawBitmap(0, 0, title, 128, 64, WHITE);
  if(arduboy.justPressed(A_BUTTON)) {
    gamestate = GAME_PLAY;
  }
}

void gameplay() {
  spikeyMovement();
  drawMap();
  drawSpikey();
  drawplayer();
  playerinput();
  
  if (arduboy.everyXFrames(24)) {
   score++;
  }
  
 //Left side of the player collision
      if(spikey.x == player.x + PLAYER_WIDTH and player.y < spikey.y + SPIKEY_HEIGHT and player.y + PLAYER_HEIGHT > spikey.y) {
        gamestate = GAME_OVER;
       }
       //Right side of the player colision
       if(spikey.x + SPIKEY_WIDTH == player.x and player.y < spikey.y + SPIKEY_HEIGHT and player.y + PLAYER_HEIGHT > spikey.y) {
        gamestate = GAME_OVER;
       }
       //Up side of the player collision
       if(spikey.y + SPIKEY_HEIGHT == player.y and player.x < spikey.x + SPIKEY_WIDTH and player.x + PLAYER_WIDTH > spikey.x) {
         gamestate = GAME_OVER;
       }
       // Down side of the player collision
       if(spikey.y == player.y + PLAYER_HEIGHT and player.x < spikey.x + SPIKEY_WIDTH and player.x + PLAYER_WIDTH > spikey.x) {
         gamestate = GAME_OVER;
       }
}

void gameoverscreen() {
  arduboy.setCursor(0, 0);
  arduboy.print("Game Over Screen\n");
  if(arduboy.justPressed(A_BUTTON)) {
    gamestate = GAME_TITLE;
  }
  
  arduboy.setCursor(0, 30);
  arduboy.print("Score is: ");
  arduboy.print(score);

  spikey.x = 32;
  spikey.y = 32;
  player.x = 0;
  player.y = 32;
    
  moveRight = true;
  moveDown = true;
}


void gameloop() {
  switch(gamestate) {
    case GAME_TITLE:
      titlescreen();
      break;

    case GAME_PLAY:
      gameplay();
      break;

    case GAME_OVER:
      gameoverscreen();
      break;

  }
}



void setup() {
  arduboy.begin();
  arduboy.setFrameRate(45);
  arduboy.display();

  arduboy.initRandomSeed();
  
  arduboy.clear();
}

void loop() {
  if(!(arduboy.nextFrame())) {
    return;
  }

  arduboy.pollButtons();

  arduboy.clear();

  gameloop();

  arduboy.display();
}

